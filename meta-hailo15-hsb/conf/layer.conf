## meta-hailo15-hsb/conf/layer.conf
```bitbake
BBPATH .= ":${LAYERDIR}"

BBFILES += "${LAYERDIR}/recipes-*/*/*.bb \
            ${LAYERDIR}/recipes-*/*/*.bbappend"

BBFILE_COLLECTIONS += "hailo15-hsb"
BBFILE_PATTERN_hailo15-hsb = "^${LAYERDIR}/"
BBFILE_PRIORITY_hailo15-hsb = "10"

LAYERDEPENDS_hailo15-hsb = "core"
LAYERSERIES_COMPAT_hailo15-hsb = "kirkstone"
```
